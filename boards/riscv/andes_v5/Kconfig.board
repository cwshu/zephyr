## boards/riscv/andes_v5/Kconfig.board
```kconfig
# SPDX-License-Identifier: Apache-2.0

config BOARD_AE250
	bool "Andes AE250 Platform"
	depends on SOC_RISCV_ANDES_AE250

config BOARD_AE350
	bool "Andes AE350 Platform"
	depends on SOC_RISCV_ANDES_AE350

config BOARD_CF1_AE250
	bool "Andes CF1-AE250 Platform"
	depends on SOC_RISCV_ANDES_AE250
```

## boards/riscv/andes_v5/Kconfig.defconfig
```kconfig
# SPDX-License-Identifier: Apache-2.0

config BOARD
	default "ae250" if BOARD_AE250
	default "ae350" if BOARD_AE350
	default "cf1_ae250" if BOARD_CF1_AE250
```

## soc/riscv/riscv-privilege/andes_v5/Kconfig.defconfig.ae250
```kconfig
# SPDX-License-Identifier: Apache-2.0

if SOC_RISCV_ANDES_AE250

config SOC
	string
	default "ae250"

config MAIN_STACK_SIZE
	int
	default 1536

config TEST_EXTRA_STACKSIZE
	int
	default 1024

endif # SOC_RISCV_ANDES_AE250
```

## soc/riscv/riscv-privilege/andes_v5/Kconfig.defconfig.ae350
```kconfig
# SPDX-License-Identifier: Apache-2.0

if SOC_RISCV_ANDES_AE350

config SOC
	string
	default "ae350"

config MAIN_STACK_SIZE
	int
	default 2048

config IDLE_STACK_SIZE
	int
	default 1536

config TEST_EXTRA_STACKSIZE
	int
	default 1024

endif # SOC_RISCV_ANDES_AE350
```

## tests/kernel/mem_protect/syscalls/testcase.yaml
```yaml
tests:
  kernel.memory_protection.syscalls:
    filter: CONFIG_ARCH_HAS_USERSPACE
    tags: kernel security userspace ignore_faults
    platform_exclude: qemu_riscv32
  kernel.memory_protection.syscalls.qemu_riscv32:
    filter: CONFIG_ARCH_HAS_USERSPACE
    tags: kernel security userspace ignore_faults
    platform_allow: qemu_riscv32
    timeout: 120
```
